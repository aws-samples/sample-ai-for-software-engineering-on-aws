## samples/embedded-development/in-vehicle-dev-server/bench/image/br2-external/Config.in
```kconfig
# SPDX-License-Identifier: MIT-0
# Copyright Amazon.com, Inc. or its affiliates. All Rights Reserved.
source "$BR2_EXTERNAL_CC1_PATH/package/cc1-bench/Config.in"
```

## samples/embedded-development/in-vehicle-dev-server/bench/image/br2-external/package/cc1-bench/Config.in
```kconfig
config BR2_PACKAGE_CC1_BENCH
	bool "cc1-bench"
	depends on BR2_INSTALL_LIBSTDCPP
	help
	  The bench's drive player, replay clients and helpers inside the emulated CC-1 (synthetic).
```
